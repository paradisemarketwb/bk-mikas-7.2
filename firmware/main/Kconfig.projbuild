## firmware/main/Kconfig.projbuild
```kconfig
menu "BK Mikas R2"
config BK_ENABLE_KLINE
    bool "Enable ECU diagnostics with selected transport"
    default n
    help
        Enable only after the selected transport's wiring is checked.
        UART requires the R2 interface; USB-KKL requires an externally powered
        native USB host connection and the R2 harness fully disconnected.
choice BK_TRANSPORT
    prompt "ECU transport"
    default BK_TRANSPORT_UART
config BK_TRANSPORT_UART
    bool "UART GPIO43/44 + L9637D, ARM GPIO19"
config BK_TRANSPORT_USB_KKL
    bool "USB Host + FTDI FT232RL KKL (0403:6001)"
    depends on SOC_USB_OTG_SUPPORTED && !ESP_CONSOLE_USB_CDC && !ESP_CONSOLE_USB_SERIAL_JTAG && !ESP_CONSOLE_SECONDARY_USB_SERIAL_JTAG
endchoice
config BK_ENABLE_WIFI
    bool "Enable password-protected local SoftAP"
    default y
endmenu
```

## firmware/sdkconfig.defaults
```kconfig
CONFIG_IDF_TARGET="esp32s3"
CONFIG_ESP_CONSOLE_NONE=y
CONFIG_ESPTOOLPY_FLASHSIZE_16MB=y
CONFIG_SPIRAM=y
CONFIG_SPIRAM_MODE_OCT=y
CONFIG_SPIRAM_SPEED_80M=y
CONFIG_FREERTOS_HZ=1000
CONFIG_ESP_MAIN_TASK_STACK_SIZE=8192
CONFIG_LV_FONT_MONTSERRAT_48=y
CONFIG_LV_USE_QRCODE=y
CONFIG_LV_OS_NONE=y
CONFIG_LV_USE_CLIB_MALLOC=y
CONFIG_LCD_RGB_RESTART_IN_VSYNC=y
CONFIG_PARTITION_TABLE_CUSTOM=y
CONFIG_PARTITION_TABLE_CUSTOM_FILENAME="partitions.csv"
CONFIG_LV_BUILD_EXAMPLES=n
CONFIG_LV_BUILD_DEMOS=n
CONFIG_ESP_CONSOLE_SECONDARY_NONE=y
CONFIG_USJ_ENABLE_USB_SERIAL_JTAG=n

CONFIG_BK_ENABLE_WIFI=y
```
